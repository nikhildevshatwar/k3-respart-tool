/**
 * @cliArgs --device "J721E_DRA829_TDA4VM_AM752x" --package "ALF" --part "Default" --product "K3-Respart-Tool@version_1"
 * @versions {"data":"20181113","timestamp":"2020052503","tool":"1.6.0+1393","templates":"20190604"}
 */

/**
 * Import the modules used in this configuration.
 */
const sysfwResPart   = scripting.addModule("/modules/sysfwResPart", {}, false);
const sysfwResPart1  = sysfwResPart.addInstance();
const sysfwResPart2  = sysfwResPart.addInstance();
const sysfwResPart3  = sysfwResPart.addInstance();
const sysfwResPart4  = sysfwResPart.addInstance();
const sysfwResPart5  = sysfwResPart.addInstance();
const sysfwResPart6  = sysfwResPart.addInstance();
const sysfwResPart7  = sysfwResPart.addInstance();
const sysfwResPart8  = sysfwResPart.addInstance();
const sysfwResPart9  = sysfwResPart.addInstance();
const sysfwResPart10 = sysfwResPart.addInstance();
const sysfwResPart11 = sysfwResPart.addInstance();

/**
 * Write custom configuration values to the imported modules.
 */
sysfwResPart1.hostName                                                      = "A72_2";
sysfwResPart1.Main_GPIO_Interrupt_router_count                              = 16;
sysfwResPart1.Wakeup_GPIO_Interrupt_router_count                            = 4;
sysfwResPart1.Main_NAVSS_UDMA_Interrupt_aggregator_Virtual_interrupts_count = 86;
sysfwResPart1.Main_NAVSS_UDMA_Interrupt_aggregator_Global_events_count      = 1024;
sysfwResPart1.Main_NAVSS_Non_secure_proxies_count                           = 4;
sysfwResPart1.Main_NAVSS_Ringacc_Free_rings_count                           = 150;
sysfwResPart1.Main_NAVSS_Ring_monitors_count                                = 3;
sysfwResPart1.Main_NAVSS_UDMA_Rx_free_flows_count                           = 16;
sysfwResPart1.Main_NAVSS_UDMA_Normal_capacity_Rx_channels_count             = 36;
sysfwResPart1.Main_NAVSS_UDMA_High_capacity_Rx_channels_count               = 4;
sysfwResPart1.Main_NAVSS_UDMA_Ultra_high_capacity_Rx_channels_count         = 2;
sysfwResPart1.Main_NAVSS_UDMA_Normal_capacity_Tx_channels_count             = 36;
sysfwResPart1.Main_NAVSS_UDMA_High_capacity_Tx_channels_count               = 4;
sysfwResPart1.Main_NAVSS_UDMA_Ultra_high_capacity_Tx_channels_count         = 2;
sysfwResPart1.Main_NAVSS_Interrupt_router_count                             = 100;
sysfwResPart1.MCU_NAVSS_Interrupt_aggregator_Virtual_interrupts_count       = 32;
sysfwResPart1.MCU_NAVSS_Interrupt_aggregator_Global_events_count            = 128;
sysfwResPart1.MCU_NAVSS_Non_secure_proxies_count                            = 4;
sysfwResPart1.MCU_NAVSS_Ringacc_free_rings_count                            = 20;
sysfwResPart1.MCU_NAVSS_Ring_monitors_count                                 = 3;
sysfwResPart1.MCU_NAVSS_UDMA_Rx_free_flows_count                            = 8;
sysfwResPart1.MCU_NAVSS_UDMA_Normal_capacity_Rx_channels_count              = 12;
sysfwResPart1.MCU_NAVSS_UDMA_Normal_capacity_Tx_channels_count              = 12;

sysfwResPart2.hostName                                                      = "A72_3";
sysfwResPart2.Main_GPIO_Interrupt_router_count                              = 4;
sysfwResPart2.Wakeup_GPIO_Interrupt_router_count                            = 2;
sysfwResPart2.Main_NAVSS_UDMA_Interrupt_aggregator_Virtual_interrupts_count = 32;
sysfwResPart2.Main_NAVSS_UDMA_Interrupt_aggregator_Global_events_count      = 512;
sysfwResPart2.Main_NAVSS_Non_secure_proxies_count                           = 4;
sysfwResPart2.Main_NAVSS_Ringacc_Free_rings_count                           = 40;
sysfwResPart2.Main_NAVSS_Ring_monitors_count                                = 2;
sysfwResPart2.Main_NAVSS_UDMA_Rx_free_flows_count                           = 16;
sysfwResPart2.Main_NAVSS_UDMA_Normal_capacity_Rx_channels_count             = 20;
sysfwResPart2.Main_NAVSS_UDMA_Normal_capacity_Tx_channels_count             = 20;
sysfwResPart2.Main_NAVSS_Interrupt_router_count                             = 32;
sysfwResPart2.MCU_NAVSS_Interrupt_aggregator_Virtual_interrupts_count       = 16;
sysfwResPart2.MCU_NAVSS_Interrupt_aggregator_Global_events_count            = 128;
sysfwResPart2.MCU_NAVSS_Non_secure_proxies_count                            = 4;
sysfwResPart2.MCU_NAVSS_Ringacc_free_rings_count                            = 8;
sysfwResPart2.MCU_NAVSS_Ring_monitors_count                                 = 2;
sysfwResPart2.MCU_NAVSS_UDMA_Rx_free_flows_count                            = 4;
sysfwResPart2.MCU_NAVSS_UDMA_Normal_capacity_Rx_channels_count              = 6;
sysfwResPart2.MCU_NAVSS_UDMA_Normal_capacity_Tx_channels_count              = 6;

sysfwResPart3.hostName                                                 = "MCU_0_R5_0";
sysfwResPart3.Main_2_MCU_Level_Interrupt_router_count                  = 32;
sysfwResPart3.Main_2_MCU_Pulse_Interrupt_router_count                  = 24;
sysfwResPart3.Main_GPIO_Interrupt_router_count                         = 8;
sysfwResPart3.Wakeup_GPIO_Interrupt_router_count                       = 8;
sysfwResPart3.Main_NAVSS_UDMA_Interrupt_aggregator_Global_events_count = 32;
sysfwResPart3.Main_NAVSS_Non_secure_proxies_count                      = 4;
sysfwResPart3.Main_NAVSS_Ringacc_Free_rings_count                      = 6;
sysfwResPart3.Main_NAVSS_UDMA_Normal_capacity_Rx_channels_count        = 2;
sysfwResPart3.Main_NAVSS_UDMA_Normal_capacity_Tx_channels_count        = 2;
sysfwResPart3.Main_NAVSS_Interrupt_router_count                        = 4;
sysfwResPart3.MCU_NAVSS_Interrupt_aggregator_Virtual_interrupts_count  = 64;
sysfwResPart3.MCU_NAVSS_Interrupt_aggregator_Global_events_count       = 256;
sysfwResPart3.MCU_NAVSS_Non_secure_proxies_count                       = 4;
sysfwResPart3.MCU_NAVSS_Ringacc_free_rings_count                       = 32;
sysfwResPart3.MCU_NAVSS_Ring_monitors_count                            = 3;
sysfwResPart3.MCU_NAVSS_UDMA_Rx_free_flows_count                       = 8;
sysfwResPart3.MCU_NAVSS_UDMA_Normal_capacity_Rx_channels_count         = 5;
sysfwResPart3.MCU_NAVSS_UDMA_High_capacity_Rx_channels_count           = 2;
sysfwResPart3.MCU_NAVSS_UDMA_Normal_capacity_Tx_channels_count         = 5;
sysfwResPart3.MCU_NAVSS_UDMA_High_capacity_Tx_channels_count           = 2;
sysfwResPart3.MCU_NAVSS_Interrupt_router_count                         = 28;

sysfwResPart4.hostName                                                 = "MCU_0_R5_2";
sysfwResPart4.Main_2_MCU_Level_Interrupt_router_count                  = 32;
sysfwResPart4.Main_2_MCU_Pulse_Interrupt_router_count                  = 24;
sysfwResPart4.Main_GPIO_Interrupt_router_count                         = 8;
sysfwResPart4.Wakeup_GPIO_Interrupt_router_count                       = 8;
sysfwResPart4.Main_NAVSS_UDMA_Interrupt_aggregator_Global_events_count = 32;
sysfwResPart4.Main_NAVSS_Non_secure_proxies_count                      = 4;
sysfwResPart4.Main_NAVSS_Ringacc_Free_rings_count                      = 6;
sysfwResPart4.Main_NAVSS_Ring_monitors_count                           = 1;
sysfwResPart4.Main_NAVSS_UDMA_Normal_capacity_Rx_channels_count        = 2;
sysfwResPart4.Main_NAVSS_UDMA_Normal_capacity_Tx_channels_count        = 2;
sysfwResPart4.Main_NAVSS_Interrupt_router_count                        = 4;
sysfwResPart4.MCU_NAVSS_Interrupt_aggregator_Virtual_interrupts_count  = 4;
sysfwResPart4.MCU_NAVSS_Interrupt_aggregator_Global_events_count       = 64;
sysfwResPart4.MCU_NAVSS_Non_secure_proxies_count                       = 4;
sysfwResPart4.MCU_NAVSS_Ringacc_free_rings_count                       = 12;
sysfwResPart4.MCU_NAVSS_Ring_monitors_count                            = 3;
sysfwResPart4.MCU_NAVSS_UDMA_Rx_free_flows_count                       = 4;
sysfwResPart4.MCU_NAVSS_UDMA_Normal_capacity_Rx_channels_count         = 2;
sysfwResPart4.MCU_NAVSS_UDMA_Normal_capacity_Tx_channels_count         = 2;
sysfwResPart4.MCU_NAVSS_Interrupt_router_count                         = 28;

sysfwResPart5.hostName                                                      = "MAIN_1_R5_0";
sysfwResPart5.Main_GPIO_Interrupt_router_count                              = 4;
sysfwResPart5.Interrupt_router_for_Main_R5F_Subsystem1_count                = 128;
sysfwResPart5.Wakeup_GPIO_Interrupt_router_count                            = 2;
sysfwResPart5.Main_NAVSS_UDMA_Interrupt_aggregator_Virtual_interrupts_count = 12;
sysfwResPart5.Main_NAVSS_UDMA_Interrupt_aggregator_Global_events_count      = 256;
sysfwResPart5.Main_NAVSS_Non_secure_proxies_count                           = 4;
sysfwResPart5.Main_NAVSS_Ringacc_Free_rings_count                           = 10;
sysfwResPart5.Main_NAVSS_Ring_monitors_count                                = 3;
sysfwResPart5.Main_NAVSS_UDMA_Normal_capacity_Rx_channels_count             = 6;
sysfwResPart5.Main_NAVSS_UDMA_Normal_capacity_Tx_channels_count             = 6;
sysfwResPart5.Main_NAVSS_Interrupt_router_count                             = 28;
sysfwResPart5.MCU_NAVSS_Interrupt_aggregator_Virtual_interrupts_count       = 16;
sysfwResPart5.MCU_NAVSS_Interrupt_aggregator_Global_events_count            = 128;
sysfwResPart5.MCU_NAVSS_Non_secure_proxies_count                            = 4;
sysfwResPart5.MCU_NAVSS_Ringacc_free_rings_count                            = 8;
sysfwResPart5.MCU_NAVSS_Ring_monitors_count                                 = 3;
sysfwResPart5.MCU_NAVSS_UDMA_Rx_free_flows_count                            = 4;
sysfwResPart5.MCU_NAVSS_UDMA_Normal_capacity_Rx_channels_count              = 2;
sysfwResPart5.MCU_NAVSS_UDMA_Normal_capacity_Tx_channels_count              = 2;

sysfwResPart6.hostName                                                      = "MAIN_1_R5_2";
sysfwResPart6.Main_GPIO_Interrupt_router_count                              = 4;
sysfwResPart6.Interrupt_router_for_Main_R5F_Subsystem1_count                = 128;
sysfwResPart6.Wakeup_GPIO_Interrupt_router_count                            = 2;
sysfwResPart6.Main_NAVSS_UDMA_Interrupt_aggregator_Virtual_interrupts_count = 12;
sysfwResPart6.Main_NAVSS_UDMA_Interrupt_aggregator_Global_events_count      = 256;
sysfwResPart6.Main_NAVSS_Non_secure_proxies_count                           = 4;
sysfwResPart6.Main_NAVSS_Ringacc_Free_rings_count                           = 10;
sysfwResPart6.Main_NAVSS_Ring_monitors_count                                = 3;
sysfwResPart6.Main_NAVSS_UDMA_Normal_capacity_Rx_channels_count             = 6;
sysfwResPart6.Main_NAVSS_UDMA_Normal_capacity_Tx_channels_count             = 6;
sysfwResPart6.Main_NAVSS_Interrupt_router_count                             = 28;
sysfwResPart6.MCU_NAVSS_Interrupt_aggregator_Virtual_interrupts_count       = 16;
sysfwResPart6.MCU_NAVSS_Interrupt_aggregator_Global_events_count            = 128;
sysfwResPart6.MCU_NAVSS_Non_secure_proxies_count                            = 4;
sysfwResPart6.MCU_NAVSS_Ringacc_free_rings_count                            = 8;
sysfwResPart6.MCU_NAVSS_Ring_monitors_count                                 = 3;
sysfwResPart6.MCU_NAVSS_UDMA_Rx_free_flows_count                            = 4;
sysfwResPart6.MCU_NAVSS_UDMA_Normal_capacity_Rx_channels_count              = 2;
sysfwResPart6.MCU_NAVSS_UDMA_Normal_capacity_Tx_channels_count              = 2;

sysfwResPart7.hostName                                                      = "C7X_1";
sysfwResPart7.Main_GPIO_Interrupt_router_count                              = 4;
sysfwResPart7.Wakeup_GPIO_Interrupt_router_count                            = 2;
sysfwResPart7.Main_NAVSS_UDMA_Interrupt_aggregator_Virtual_interrupts_count = 12;
sysfwResPart7.Main_NAVSS_UDMA_Interrupt_aggregator_Global_events_count      = 256;
sysfwResPart7.Main_NAVSS_Non_secure_proxies_count                           = 4;
sysfwResPart7.Main_NAVSS_Ringacc_Free_rings_count                           = 32;
sysfwResPart7.Main_NAVSS_Ring_monitors_count                                = 3;
sysfwResPart7.Main_NAVSS_UDMA_Normal_capacity_Rx_channels_count             = 6;
sysfwResPart7.Main_NAVSS_UDMA_Normal_capacity_Tx_channels_count             = 6;
sysfwResPart7.Main_NAVSS_UDMA_extended_Tx_channels_count                    = 16;
sysfwResPart7.Main_NAVSS_Interrupt_router_count                             = 46;
sysfwResPart7.MCU_NAVSS_Interrupt_aggregator_Virtual_interrupts_count       = 8;
sysfwResPart7.MCU_NAVSS_Interrupt_aggregator_Global_events_count            = 64;
sysfwResPart7.MCU_NAVSS_Non_secure_proxies_count                            = 4;
sysfwResPart7.MCU_NAVSS_Ringacc_free_rings_count                            = 8;
sysfwResPart7.MCU_NAVSS_Ring_monitors_count                                 = 3;
sysfwResPart7.MCU_NAVSS_UDMA_Normal_capacity_Rx_channels_count              = 2;
sysfwResPart7.MCU_NAVSS_UDMA_Normal_capacity_Tx_channels_count              = 2;

sysfwResPart8.hostName                                                      = "C6X_0_1";
sysfwResPart8.Interrupt_router_for_C6X_subsystem0_count                     = 93;
sysfwResPart8.Main_GPIO_Interrupt_router_count                              = 4;
sysfwResPart8.Main_NAVSS_UDMA_Interrupt_aggregator_Virtual_interrupts_count = 12;
sysfwResPart8.Main_NAVSS_UDMA_Interrupt_aggregator_Global_events_count      = 256;
sysfwResPart8.Main_NAVSS_Non_secure_proxies_count                           = 4;
sysfwResPart8.Main_NAVSS_Ringacc_Free_rings_count                           = 38;
sysfwResPart8.Main_NAVSS_Ring_monitors_count                                = 3;
sysfwResPart8.Main_NAVSS_UDMA_Normal_capacity_Rx_channels_count             = 16;
sysfwResPart8.Main_NAVSS_UDMA_Normal_capacity_Tx_channels_count             = 16;
sysfwResPart8.Main_NAVSS_UDMA_extended_Tx_channels_count                    = 6;
sysfwResPart8.Main_NAVSS_Interrupt_router_count                             = 24;
sysfwResPart8.MCU_NAVSS_Interrupt_aggregator_Virtual_interrupts_count       = 8;
sysfwResPart8.MCU_NAVSS_Interrupt_aggregator_Global_events_count            = 64;
sysfwResPart8.MCU_NAVSS_Non_secure_proxies_count                            = 4;
sysfwResPart8.MCU_NAVSS_Ringacc_free_rings_count                            = 8;
sysfwResPart8.MCU_NAVSS_Ring_monitors_count                                 = 3;
sysfwResPart8.MCU_NAVSS_UDMA_Normal_capacity_Rx_channels_count              = 2;
sysfwResPart8.MCU_NAVSS_UDMA_Normal_capacity_Tx_channels_count              = 2;

sysfwResPart9.hostName                                                      = "C6X_1_1";
sysfwResPart9.Interrupt_router_for_C6X_subsystem1_count                     = 93;
sysfwResPart9.Main_GPIO_Interrupt_router_count                              = 4;
sysfwResPart9.Main_NAVSS_UDMA_Interrupt_aggregator_Virtual_interrupts_count = 12;
sysfwResPart9.Main_NAVSS_UDMA_Interrupt_aggregator_Global_events_count      = 256;
sysfwResPart9.Main_NAVSS_Non_secure_proxies_count                           = 4;
sysfwResPart9.Main_NAVSS_Ringacc_Free_rings_count                           = 12;
sysfwResPart9.Main_NAVSS_Ring_monitors_count                                = 3;
sysfwResPart9.Main_NAVSS_UDMA_Normal_capacity_Rx_channels_count             = 8;
sysfwResPart9.Main_NAVSS_UDMA_Normal_capacity_Tx_channels_count             = 8;
sysfwResPart9.Main_NAVSS_UDMA_extended_Tx_channels_count                    = 6;
sysfwResPart9.Main_NAVSS_Interrupt_router_count                             = 24;
sysfwResPart9.MCU_NAVSS_Interrupt_aggregator_Virtual_interrupts_count       = 8;
sysfwResPart9.MCU_NAVSS_Interrupt_aggregator_Global_events_count            = 64;
sysfwResPart9.MCU_NAVSS_Non_secure_proxies_count                            = 4;
sysfwResPart9.MCU_NAVSS_Ringacc_free_rings_count                            = 8;
sysfwResPart9.MCU_NAVSS_Ring_monitors_count                                 = 3;
sysfwResPart9.MCU_NAVSS_UDMA_Normal_capacity_Rx_channels_count              = 2;
sysfwResPart9.MCU_NAVSS_UDMA_Normal_capacity_Tx_channels_count              = 2;

sysfwResPart10.hostName                                                      = "MAIN_0_R5_0";
sysfwResPart10.Main_GPIO_Interrupt_router_count                              = 4;
sysfwResPart10.Interrupt_router_for_Main_R5F_Subsystem0_count                = 128;
sysfwResPart10.Wakeup_GPIO_Interrupt_router_count                            = 2;
sysfwResPart10.Main_NAVSS_UDMA_Interrupt_aggregator_Virtual_interrupts_count = 28;
sysfwResPart10.Main_NAVSS_UDMA_Interrupt_aggregator_Global_events_count      = 512;
sysfwResPart10.Main_NAVSS_Non_secure_proxies_count                           = 12;
sysfwResPart10.Main_NAVSS_Ringacc_Free_rings_count                           = 182;
sysfwResPart10.Main_NAVSS_Ring_monitors_count                                = 6;
sysfwResPart10.Main_NAVSS_UDMA_Normal_capacity_Rx_channels_count             = 20;
sysfwResPart10.Main_NAVSS_UDMA_High_capacity_Rx_channels_count               = 6;
sysfwResPart10.Main_NAVSS_UDMA_Ultra_high_capacity_Rx_channels_count         = 2;
sysfwResPart10.Main_NAVSS_UDMA_Normal_capacity_Tx_channels_count             = 14;
sysfwResPart10.Main_NAVSS_UDMA_extended_Tx_channels_count                    = 132;
sysfwResPart10.Main_NAVSS_UDMA_High_capacity_Tx_channels_count               = 6;
sysfwResPart10.Main_NAVSS_UDMA_Ultra_high_capacity_Tx_channels_count         = 2;
sysfwResPart10.Main_NAVSS_Interrupt_router_count                             = 28;
sysfwResPart10.MCU_NAVSS_Interrupt_aggregator_Virtual_interrupts_count       = 24;
sysfwResPart10.MCU_NAVSS_Interrupt_aggregator_Global_events_count            = 128;
sysfwResPart10.MCU_NAVSS_Non_secure_proxies_count                            = 16;
sysfwResPart10.MCU_NAVSS_Ringacc_free_rings_count                            = 16;
sysfwResPart10.MCU_NAVSS_Ring_monitors_count                                 = 3;
sysfwResPart10.MCU_NAVSS_UDMA_Rx_free_flows_count                            = 8;
sysfwResPart10.MCU_NAVSS_UDMA_Normal_capacity_Rx_channels_count              = 3;
sysfwResPart10.MCU_NAVSS_UDMA_Normal_capacity_Tx_channels_count              = 3;

sysfwResPart11.hostName                                                      = "MAIN_0_R5_2";
sysfwResPart11.Main_GPIO_Interrupt_router_count                              = 4;
sysfwResPart11.Interrupt_router_for_Main_R5F_Subsystem0_count                = 128;
sysfwResPart11.Wakeup_GPIO_Interrupt_router_count                            = 2;
sysfwResPart11.Main_NAVSS_UDMA_Interrupt_aggregator_Virtual_interrupts_count = 8;
sysfwResPart11.Main_NAVSS_UDMA_Interrupt_aggregator_Global_events_count      = 256;
sysfwResPart11.Main_NAVSS_Non_secure_proxies_count                           = 4;
sysfwResPart11.Main_NAVSS_Ringacc_Free_rings_count                           = 40;
sysfwResPart11.Main_NAVSS_Ring_monitors_count                                = 3;
sysfwResPart11.Main_NAVSS_UDMA_Normal_capacity_Rx_channels_count             = 2;
sysfwResPart11.Main_NAVSS_UDMA_Normal_capacity_Tx_channels_count             = 6;
sysfwResPart11.Main_NAVSS_Interrupt_router_count                             = 28;
sysfwResPart11.MCU_NAVSS_Interrupt_aggregator_Virtual_interrupts_count       = 8;
sysfwResPart11.MCU_NAVSS_Interrupt_aggregator_Global_events_count            = 128;
sysfwResPart11.MCU_NAVSS_Non_secure_proxies_count                            = 4;
sysfwResPart11.MCU_NAVSS_Ringacc_free_rings_count                            = 8;
sysfwResPart11.MCU_NAVSS_Ring_monitors_count                                 = 3;
sysfwResPart11.MCU_NAVSS_UDMA_Rx_free_flows_count                            = 4;
sysfwResPart11.MCU_NAVSS_UDMA_Normal_capacity_Rx_channels_count              = 2;
sysfwResPart11.MCU_NAVSS_UDMA_Normal_capacity_Tx_channels_count              = 2;
