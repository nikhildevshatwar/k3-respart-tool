/**
 * These arguments were used when this file was generated. They will be automatically applied on subsequent loads
 * via the GUI or CLI. Run CLI with '--help' for additional information on how to override these arguments.
 * @cliArgs --device "J721E_DRA829_TDA4VM_AM752x" --package "ALF" --part "Default" --product "K3-Respart-Tool@version_1"
 * @versions {"data":"20181113","timestamp":"2020052503","tool":"1.6.0+1393","templates":"20190604"}
 */

/**
 * Import the modules used in this configuration.
 */
const qosConfig     = scripting.addModule("/modules/qosConfig", {}, false);
const qosConfig1    = qosConfig.addInstance();
const qosConfig2    = qosConfig.addInstance();
const qosConfig3    = qosConfig.addInstance();
const qosConfig4    = qosConfig.addInstance();
const sysfwResPart  = scripting.addModule("/modules/sysfwResPart", {}, false);
const sysfwResPart1 = sysfwResPart.addInstance();
const sysfwResPart2 = sysfwResPart.addInstance();
const sysfwResPart3 = sysfwResPart.addInstance();
const sysfwResPart4 = sysfwResPart.addInstance();

/**
 * Write custom configuration values to the imported modules.
 */
qosConfig1.qosdev    = "MCU_R5FSS0_MEMBDG_WMST1";
qosConfig1.atype     = 1;
qosConfig1.virtId    = 5;
qosConfig1.orderId   = 4;
qosConfig1.qos       = 6;
qosConfig1.epriority = 1;

qosConfig2.qosdev = "NAVSS0_RINGACC0_DST";

qosConfig3.qosdev    = "PRU_ICSSG0_PR1_EXT_VBUSM";
qosConfig3.chan      = "5";
qosConfig3.orderId   = 2;
qosConfig3.epriority = 7;

qosConfig4.qosdev  = "DSS0_DSS_INST0_VBUSM_DMA";
qosConfig4.chan    = "3";
qosConfig4.virtId  = 3;
qosConfig4.orderId = 5;
qosConfig4.qos     = 6;

sysfwResPart1.hostName                                             = "A72_4";
sysfwResPart1.Main_NAVSS_UDMA_High_capacity_Rx_channels_count      = 3;
sysfwResPart1.Main_NAVSS_UDMA_High_capacity_Rx_channels_blockCount = 4;
sysfwResPart1.Main_NAVSS_Ringacc_virt_id_range_start               = 2;
sysfwResPart1.Main_NAVSS_Ringacc_virt_id_range_count               = 9;

sysfwResPart2.hostName                                                 = "MCU_0_R5_2";
sysfwResPart2.Main_NAVSS_UDMA_High_capacity_Rx_channels_count          = 2;
sysfwResPart2.Main_NAVSS_UDMA_High_capacity_Rx_channels_blockCount     = 3;
sysfwResPart2.Main_NAVSS_UDMA_extended_Tx_channels_count               = 5;
sysfwResPart2.Main_NAVSS_UDMA_global_event_trigger_count               = 8;
sysfwResPart2.Main_NAVSS_Ringacc_virt_id_range_count                   = 4;
sysfwResPart2.Main_NAVSS_Ringacc_virt_id_range_start                   = 12;
sysfwResPart2.MCU_NAVSS_Ring_monitors_count                            = 5;
sysfwResPart2.Main_NAVSS_UDMA_Interrupt_aggregator_Global_events_count = 3;
sysfwResPart2.MCU_NAVSS_Interrupt_aggregator_Virtual_interrupts_count  = 4;

sysfwResPart3.hostName                                                      = "C6X_0_0";
sysfwResPart3.Main_NAVSS_invalid_flow_event_config_count                    = 1;
sysfwResPart3.Main_NAVSS_UDMA_global_event_trigger_count                    = 6;
sysfwResPart3.Main_NAVSS_UDMA_extended_Tx_channels_count                    = 3;
sysfwResPart3.Main_NAVSS_Ringacc_virt_id_range_count                        = 4;
sysfwResPart3.Main_NAVSS_Ringacc_virt_id_range_start                        = 16;
sysfwResPart3.Main_NAVSS_UDMA_Interrupt_aggregator_Virtual_interrupts_count = 2;
sysfwResPart3.Main_NAVSS_UDMA_Interrupt_aggregator_Global_events_count      = 6;
sysfwResPart3.Interrupt_router_for_C6X_subsystem0_count                     = 5;

sysfwResPart4.hostName = "MAIN_0_R5_3";
