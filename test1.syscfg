/**
 * @cliArgs --device "J721E_DRA829_TDA4VM_AM752x" --package "ALF" --part "Default" --product "K3-Respart-Tool@version_1"
 * @versions {"data":"20181113","timestamp":"2020021217","tool":"1.4.0+1234","templates":"20190604"}
 */

/**
 * Import the modules used in this configuration.
 */
const resourceEntry  = scripting.addModule("/modules/resourceEntry", {}, false);
const resourceEntry1 = resourceEntry.addInstance();
const resourceEntry2 = resourceEntry.addInstance();
const resourceEntry3 = resourceEntry.addInstance();

/**
 * Write custom configuration values to the imported modules.
 */
resourceEntry1.$name    = "moduleResoutrcedshbn";
resourceEntry1.resType  = "Unique resource";
resourceEntry1.devId    = "Random Id";
resourceEntry1.subtype  = "RESASG_SUBTYPE_UDMAsubtyoe_TX_CHAN";
resourceEntry1.hostId   = "hgsdbnc";
resourceEntry1.resCount = 23;

resourceEntry2.resType  = "sdkjdhjnkcmfv";
resourceEntry2.devId    = "hsdbdnc m";
resourceEntry2.subtype  = "sdjgjbhcn ";
resourceEntry2.resCount = 454;
resourceEntry2.hostId   = "khsjdm";
resourceEntry2.$name    = "dfsdhbvd";

resourceEntry3.$name    = "fiuerhgbjm";
resourceEntry3.resType  = "kjsrrgnbmdfb";
resourceEntry3.devId    = "jfgbmv";
resourceEntry3.subtype  = "jutuothjmrtgu";
resourceEntry3.resCount = 4543;
resourceEntry3.hostId   = "tjgjnb mv";
