/**
 * @cliArgs --device "AM65xx_SR1.0" --package "ACD" --part "Default" --product "K3-Respart-Tool@version_1"
 * @versions {"data":"20190916","timestamp":"2020052503","tool":"1.6.0+1393","templates":"20190916"}
 */

/**
 * Import the modules used in this configuration.
 */
const sysfwResPart  = scripting.addModule("/modules/sysfwResPart", {}, false);
const sysfwResPart1 = sysfwResPart.addInstance();
const sysfwResPart2 = sysfwResPart.addInstance();
const sysfwResPart3 = sysfwResPart.addInstance();
const sysfwResPart4 = sysfwResPart.addInstance();

/**
 * Write custom configuration values to the imported modules.
 */
sysfwResPart1.hostName                                                      = "A53_2";
sysfwResPart1.Compare_event_Interrupt_router_count                          = 12;
sysfwResPart1.Main_GPIO_Interrupt_Router_count                              = 20;
sysfwResPart1.Main_NAVSS_Interrupt_Router_count                             = 64;
sysfwResPart1.Main_NAVSS_Non_secure_proxies_count                           = 12;
sysfwResPart1.Main_NAVSS_Ringacc_free_rings_count                           = 100;
sysfwResPart1.Main_NAVSS_Ringacc_virt_id_range_start                        = 2;
sysfwResPart1.Main_NAVSS_Ringacc_virt_id_range_count                        = 1;
sysfwResPart1.Main_NAVSS_Ring_monitors_count                                = 8;
sysfwResPart1.Main_NAVSS_UDMA_Rx_Free_flows_count                           = 64;
sysfwResPart1.Main_NAVSS_UDMA_Normal_capacity_Rx_channels_count             = 64;
sysfwResPart1.Main_NAVSS_UDMA_High_capacity_Rx_channels_count               = 2;
sysfwResPart1.Main_NAVSS_UDMA_Normal_capacity_Tx_channels_count             = 50;
sysfwResPart1.Main_NAVSS_UDMA_extended_Tx_channels_count                    = 4;
sysfwResPart1.Main_NAVSS_UDMA_High_capacity_Tx_channels_count               = 3;
sysfwResPart1.Main_NAVSS_UDMA_Interrupt_aggregator_Virtual_interrupts_count = 80;
sysfwResPart1.Main_NAVSS_UDMA_Interrupt_aggregator_Global_events_count      = 1024;
sysfwResPart1.MCU_NAVSS_Non_secure_proxies_count                            = 12;
sysfwResPart1.MCU_NAVSS_Ringacc_free_rings_count                            = 32;
sysfwResPart1.MCU_NAVSS_Ring_monitors_count                                 = 8;
sysfwResPart1.MCU_NAVSS_UDMA_Rx_free_flows_count                            = 16;
sysfwResPart1.MCU_NAVSS_UDMA_Normal_capacity_Rx_channels_count              = 14;
sysfwResPart1.MCU_NAVSS_UDMA_Normal_capacity_Tx_channels_count              = 14;
sysfwResPart1.MCU_NAVSS_Interrupt_aggregator_Virtual_interrupts_count       = 80;
sysfwResPart1.MCU_NAVSS_Interrupt_aggregator_Global_events_count            = 512;
sysfwResPart1.Wakeup_GPIO_Interrupt_router_count                            = 4;

sysfwResPart2.hostName                                                      = "A53_3";
sysfwResPart2.Compare_event_Interrupt_router_count                          = 4;
sysfwResPart2.Main_GPIO_Interrupt_Router_count                              = 12;
sysfwResPart2.Main_NAVSS_Interrupt_Router_count                             = 40;
sysfwResPart2.Main_NAVSS_Non_secure_proxies_count                           = 4;
sysfwResPart2.Main_NAVSS_Ringacc_free_rings_count                           = 50;
sysfwResPart2.Main_NAVSS_Ringacc_virt_id_range_start                        = 3;
sysfwResPart2.Main_NAVSS_Ringacc_virt_id_range_count                        = 1;
sysfwResPart2.Main_NAVSS_Ring_monitors_count                                = 4;
sysfwResPart2.Main_NAVSS_UDMA_Rx_Free_flows_count                           = 8;
sysfwResPart2.Main_NAVSS_UDMA_Normal_capacity_Rx_channels_count             = 32;
sysfwResPart2.Main_NAVSS_UDMA_Normal_capacity_Tx_channels_count             = 16;
sysfwResPart2.Main_NAVSS_UDMA_extended_Tx_channels_count                    = 4;
sysfwResPart2.Main_NAVSS_UDMA_Interrupt_aggregator_Virtual_interrupts_count = 30;
sysfwResPart2.Main_NAVSS_UDMA_Interrupt_aggregator_Global_events_count      = 512;
sysfwResPart2.MCU_NAVSS_Non_secure_proxies_count                            = 4;
sysfwResPart2.MCU_NAVSS_Ringacc_free_rings_count                            = 8;
sysfwResPart2.MCU_NAVSS_Ring_monitors_count                                 = 4;
sysfwResPart2.MCU_NAVSS_UDMA_Rx_free_flows_count                            = 4;
sysfwResPart2.MCU_NAVSS_UDMA_Normal_capacity_Rx_channels_count              = 4;
sysfwResPart2.MCU_NAVSS_UDMA_Normal_capacity_Tx_channels_count              = 4;
sysfwResPart2.MCU_NAVSS_Interrupt_aggregator_Virtual_interrupts_count       = 30;
sysfwResPart2.MCU_NAVSS_Interrupt_aggregator_Global_events_count            = 128;
sysfwResPart2.Wakeup_GPIO_Interrupt_router_count                            = 4;

sysfwResPart3.hostName                                                      = "R5_0";
sysfwResPart3.Compare_event_Interrupt_router_count                          = 8;
sysfwResPart3.Main_2_MCU_Level_Interrupt_Router_count                       = 32;
sysfwResPart3.Main_2_MCU_Pulse_Interrupt_Router_count                       = 24;
sysfwResPart3.Main_NAVSS_Interrupt_Router_count                             = 4;
sysfwResPart3.Main_NAVSS_Non_secure_proxies_count                           = 16;
sysfwResPart3.Main_NAVSS_Ringacc_free_rings_count                           = 100;
sysfwResPart3.Main_NAVSS_Ring_monitors_count                                = 8;
sysfwResPart3.Main_NAVSS_UDMA_Rx_Free_flows_count                           = 64;
sysfwResPart3.Main_NAVSS_UDMA_Normal_capacity_Rx_channels_count             = 20;
sysfwResPart3.Main_NAVSS_UDMA_High_capacity_Rx_channels_count               = 2;
sysfwResPart3.Main_NAVSS_UDMA_Normal_capacity_Tx_channels_count             = 20;
sysfwResPart3.Main_NAVSS_UDMA_extended_Tx_channels_count                    = 12;
sysfwResPart3.Main_NAVSS_UDMA_High_capacity_Tx_channels_count               = 2;
sysfwResPart3.Main_NAVSS_UDMA_Interrupt_aggregator_Virtual_interrupts_count = 50;
sysfwResPart3.Main_NAVSS_UDMA_Interrupt_aggregator_Global_events_count      = 512;
sysfwResPart3.MCU_NAVSS_Interrupt_router_count                              = 28;
sysfwResPart3.MCU_NAVSS_Non_secure_proxies_count                            = 24;
sysfwResPart3.MCU_NAVSS_Ringacc_free_rings_count                            = 60;
sysfwResPart3.MCU_NAVSS_Ring_monitors_count                                 = 8;
sysfwResPart3.MCU_NAVSS_UDMA_Rx_free_flows_count                            = 16;
sysfwResPart3.MCU_NAVSS_UDMA_Normal_capacity_Rx_channels_count              = 14;
sysfwResPart3.MCU_NAVSS_UDMA_High_capacity_Rx_channels_count                = 2;
sysfwResPart3.MCU_NAVSS_UDMA_Normal_capacity_Tx_channels_count              = 14;
sysfwResPart3.MCU_NAVSS_UDMA_High_capacity_Tx_channels_count                = 2;
sysfwResPart3.MCU_NAVSS_Interrupt_aggregator_Virtual_interrupts_count       = 50;
sysfwResPart3.MCU_NAVSS_Interrupt_aggregator_Global_events_count            = 256;
sysfwResPart3.Wakeup_GPIO_Interrupt_router_count                            = 4;

sysfwResPart4.hostName                                                      = "R5_2";
sysfwResPart4.Compare_event_Interrupt_router_count                          = 8;
sysfwResPart4.Main_2_MCU_Level_Interrupt_Router_count                       = 32;
sysfwResPart4.Main_2_MCU_Pulse_Interrupt_Router_count                       = 24;
sysfwResPart4.Main_NAVSS_Interrupt_Router_count                             = 4;
sysfwResPart4.Main_NAVSS_Non_secure_proxies_count                           = 16;
sysfwResPart4.Main_NAVSS_Ringacc_free_rings_count                           = 100;
sysfwResPart4.Main_NAVSS_Ring_monitors_count                                = 8;
sysfwResPart4.Main_NAVSS_UDMA_Rx_Free_flows_count                           = 8;
sysfwResPart4.Main_NAVSS_UDMA_Normal_capacity_Rx_channels_count             = 16;
sysfwResPart4.Main_NAVSS_UDMA_High_capacity_Rx_channels_count               = 2;
sysfwResPart4.Main_NAVSS_UDMA_Normal_capacity_Tx_channels_count             = 16;
sysfwResPart4.Main_NAVSS_UDMA_extended_Tx_channels_count                    = 12;
sysfwResPart4.Main_NAVSS_UDMA_High_capacity_Tx_channels_count               = 2;
sysfwResPart4.Main_NAVSS_UDMA_Interrupt_aggregator_Virtual_interrupts_count = 50;
sysfwResPart4.Main_NAVSS_UDMA_Interrupt_aggregator_Global_events_count      = 512;
sysfwResPart4.MCU_NAVSS_Interrupt_router_count                              = 28;
sysfwResPart4.MCU_NAVSS_Non_secure_proxies_count                            = 24;
sysfwResPart4.MCU_NAVSS_Ringacc_free_rings_count                            = 60;
sysfwResPart4.MCU_NAVSS_Ring_monitors_count                                 = 8;
sysfwResPart4.MCU_NAVSS_UDMA_Rx_free_flows_count                            = 8;
sysfwResPart4.MCU_NAVSS_UDMA_Normal_capacity_Rx_channels_count              = 14;
sysfwResPart4.MCU_NAVSS_UDMA_Normal_capacity_Tx_channels_count              = 14;
sysfwResPart4.MCU_NAVSS_Interrupt_aggregator_Virtual_interrupts_count       = 50;
sysfwResPart4.MCU_NAVSS_Interrupt_aggregator_Global_events_count            = 256;
sysfwResPart4.Wakeup_GPIO_Interrupt_router_count                            = 4;
