/**
* These arguments were used when this file was generated. They will be automatically applied on subsequent loads
* via the GUI or CLI. Run CLI with '--help' for additional information on how to override these arguments.
* @cliArgs --device 'J721E_DRA829_TDA4VM_AM752x' --package 'ALF' --part 'Default' --product 'K3-Respart-Tool@version_1'
* @versions {'data':'20181113','timestamp':'2020021217','tool':'1.4.0+1234','templates':'20190604'}
*/ 





const resourceAssignments  = scripting.addModule('/modules/resourceAssignments', {}, false);
const resourceAssignments1 = resourceAssignments.addInstance();
const resourceAssignments2 = resourceAssignments.addInstance();
const resourceAssignments3 = resourceAssignments.addInstance();
const resourceAssignments4 = resourceAssignments.addInstance();
const resourceAssignments5 = resourceAssignments.addInstance();
const resourceAssignments6 = resourceAssignments.addInstance();
const resourceAssignments7 = resourceAssignments.addInstance();
const resourceAssignments8 = resourceAssignments.addInstance();
const resourceAssignments9 = resourceAssignments.addInstance();
const resourceAssignments10 = resourceAssignments.addInstance();
const resourceAssignments11 = resourceAssignments.addInstance();
const resourceAssignments12 = resourceAssignments.addInstance();
const resourceAssignments13 = resourceAssignments.addInstance();
const resourceAssignments14 = resourceAssignments.addInstance();
const resourceAssignments15 = resourceAssignments.addInstance();
const resourceAssignments16 = resourceAssignments.addInstance();
const resourceAssignments17 = resourceAssignments.addInstance();
const resourceAssignments18 = resourceAssignments.addInstance();
const resourceAssignments19 = resourceAssignments.addInstance();
const resourceAssignments20 = resourceAssignments.addInstance();
const resourceAssignments21 = resourceAssignments.addInstance();
const resourceAssignments22 = resourceAssignments.addInstance();
const resourceAssignments23 = resourceAssignments.addInstance();
const resourceAssignments24 = resourceAssignments.addInstance();
const resourceAssignments25 = resourceAssignments.addInstance();
const resourceAssignments26 = resourceAssignments.addInstance();
const resourceAssignments27 = resourceAssignments.addInstance();
const resourceAssignments28 = resourceAssignments.addInstance();
const resourceAssignments29 = resourceAssignments.addInstance();
const resourceAssignments30 = resourceAssignments.addInstance();
const resourceAssignments31 = resourceAssignments.addInstance();
const resourceAssignments32 = resourceAssignments.addInstance();
const resourceAssignments33 = resourceAssignments.addInstance();
const resourceAssignments34 = resourceAssignments.addInstance();
const resourceAssignments35 = resourceAssignments.addInstance();
const resourceAssignments36 = resourceAssignments.addInstance();
const resourceAssignments37 = resourceAssignments.addInstance();
const resourceAssignments38 = resourceAssignments.addInstance();
const resourceAssignments39 = resourceAssignments.addInstance();
const resourceAssignments40 = resourceAssignments.addInstance();
const resourceAssignments41 = resourceAssignments.addInstance();
const resourceAssignments42 = resourceAssignments.addInstance();
const resourceAssignments43 = resourceAssignments.addInstance();
const resourceAssignments44 = resourceAssignments.addInstance();
const resourceAssignments45 = resourceAssignments.addInstance();
const resourceAssignments46 = resourceAssignments.addInstance();
const resourceAssignments47 = resourceAssignments.addInstance();
const resourceAssignments48 = resourceAssignments.addInstance();
const resourceAssignments49 = resourceAssignments.addInstance();
const resourceAssignments50 = resourceAssignments.addInstance();
const resourceAssignments51 = resourceAssignments.addInstance();
const resourceAssignments52 = resourceAssignments.addInstance();
const resourceAssignments53 = resourceAssignments.addInstance();
const resourceAssignments54 = resourceAssignments.addInstance();
const resourceAssignments55 = resourceAssignments.addInstance();
const resourceAssignments56 = resourceAssignments.addInstance();
const resourceAssignments57 = resourceAssignments.addInstance();
const resourceAssignments58 = resourceAssignments.addInstance();
const resourceAssignments59 = resourceAssignments.addInstance();
const resourceAssignments60 = resourceAssignments.addInstance();
const resourceAssignments61 = resourceAssignments.addInstance();
const resourceAssignments62 = resourceAssignments.addInstance();
const resourceAssignments63 = resourceAssignments.addInstance();
const resourceAssignments64 = resourceAssignments.addInstance();
const resourceAssignments65 = resourceAssignments.addInstance();
const resourceAssignments66 = resourceAssignments.addInstance();
const resourceAssignments67 = resourceAssignments.addInstance();






resourceAssignments1.$name  =  "interrupt_router_for_c6x_0" ;
resourceAssignments1.utype  = 'Interrupt router for C6x_0' ;
resourceAssignments1.devname  = 'J721E_DEV_C66SS0_INTROUTER0' ;
resourceAssignments1.devId   = 121;
resourceAssignments1.subtype   = 'RESASG_SUBTYPE_IR_OUTPUT' ;
resourceAssignments1.subtypeid  =  0;
resourceAssignments1.resourcerangestart =  4;
resourceAssignments1.resourcecount = 93;






resourceAssignments2.$name  =  "interrupt_router_for_c6x_1" ;
resourceAssignments2.utype  = 'Interrupt router for C6x_1' ;
resourceAssignments2.devname  = 'J721E_DEV_C66SS1_INTROUTER0' ;
resourceAssignments2.devId   = 122;
resourceAssignments2.subtype   = 'RESASG_SUBTYPE_IR_OUTPUT' ;
resourceAssignments2.subtypeid  =  0;
resourceAssignments2.resourcerangestart =  4;
resourceAssignments2.resourcecount = 93;






resourceAssignments3.$name  =  "compare_event_ir" ;
resourceAssignments3.utype  = 'compare event IR' ;
resourceAssignments3.devname  = 'J721E_DEV_CMPEVENT_INTRTR0' ;
resourceAssignments3.devId   = 123;
resourceAssignments3.subtype   = 'RESASG_SUBTYPE_IR_OUTPUT' ;
resourceAssignments3.subtypeid  =  0;
resourceAssignments3.resourcerangestart =  0;
resourceAssignments3.resourcecount = 32;






resourceAssignments4.$name  =  "main_2_mcu_level_irq_ir" ;
resourceAssignments4.utype  = 'Main 2 MCU level IRQ IR' ;
resourceAssignments4.devname  = 'J721E_DEV_MAIN2MCU_LVL_INTRTR0' ;
resourceAssignments4.devId   = 128;
resourceAssignments4.subtype   = 'RESASG_SUBTYPE_IR_OUTPUT' ;
resourceAssignments4.subtypeid  =  0;
resourceAssignments4.resourcerangestart =  0;
resourceAssignments4.resourcecount = 64;






resourceAssignments5.$name  =  "main_2_mcu_pulse_irq_ir" ;
resourceAssignments5.utype  = 'Main 2 MCU Pulse IRQ IR' ;
resourceAssignments5.devname  = 'J721E_DEV_MAIN2MCU_PLS_INTRTR0' ;
resourceAssignments5.devId   = 130;
resourceAssignments5.subtype   = 'RESASG_SUBTYPE_IR_OUTPUT' ;
resourceAssignments5.subtypeid  =  0;
resourceAssignments5.resourcerangestart =  0;
resourceAssignments5.resourcecount = 48;






resourceAssignments6.$name  =  "main_gpio_ir" ;
resourceAssignments6.utype  = 'Main GPIO IR' ;
resourceAssignments6.devname  = 'J721E_DEV_GPIOMUX_INTRTR0' ;
resourceAssignments6.devId   = 131;
resourceAssignments6.subtype   = 'RESASG_SUBTYPE_IR_OUTPUT' ;
resourceAssignments6.subtypeid  =  0;
resourceAssignments6.resourcerangestart =  0;
resourceAssignments6.resourcecount = 64;






resourceAssignments7.$name  =  "interrupt_router_for_r5fss0_cluster" ;
resourceAssignments7.utype  = 'Interrupt router for R5FSS0 cluster' ;
resourceAssignments7.devname  = 'J721E_DEV_R5FSS0_INTROUTER0' ;
resourceAssignments7.devId   = 134;
resourceAssignments7.subtype   = 'RESASG_SUBTYPE_IR_OUTPUT' ;
resourceAssignments7.subtypeid  =  0;
resourceAssignments7.resourcerangestart =  0;
resourceAssignments7.resourcecount = 256;






resourceAssignments8.$name  =  "interrupt_router_for_r5fss1_cluster" ;
resourceAssignments8.utype  = 'Interrupt router for R5FSS1 cluster' ;
resourceAssignments8.devname  = 'J721E_DEV_R5FSS1_INTROUTER0' ;
resourceAssignments8.devId   = 135;
resourceAssignments8.subtype   = 'RESASG_SUBTYPE_IR_OUTPUT' ;
resourceAssignments8.subtypeid  =  0;
resourceAssignments8.resourcerangestart =  0;
resourceAssignments8.resourcecount = 256;






resourceAssignments9.$name  =  "timesync_router" ;
resourceAssignments9.utype  = 'Timesync Router' ;
resourceAssignments9.devname  = 'J721E_DEV_TIMESYNC_INTRTR0' ;
resourceAssignments9.devId   = 136;
resourceAssignments9.subtype   = 'RESASG_SUBTYPE_IR_OUTPUT' ;
resourceAssignments9.subtypeid  =  0;
resourceAssignments9.resourcerangestart =  0;
resourceAssignments9.resourcecount = 48;






resourceAssignments10.$name  =  "wkup_gpio_ir" ;
resourceAssignments10.utype  = 'WKUP GPIO IR' ;
resourceAssignments10.devname  = 'J721E_DEV_WKUP_GPIOMUX_INTRTR0' ;
resourceAssignments10.devId   = 137;
resourceAssignments10.subtype   = 'RESASG_SUBTYPE_IR_OUTPUT' ;
resourceAssignments10.subtypeid  =  0;
resourceAssignments10.resourcerangestart =  0;
resourceAssignments10.resourcecount = 32;






