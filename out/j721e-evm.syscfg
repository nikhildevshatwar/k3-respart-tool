/**
 * @cliArgs --device "J721E_DRA829_TDA4VM_AM752x" --package "ALF" --part "Default" --product "K3-Respart-Tool@0.5"
 * @versions {"data":"20181113","timestamp":"2020052503","tool":"1.6.0+1393","templates":"20190604"}
 */

/**
 * Import the modules used in this configuration.
 */
const A72_2       = scripting.addModule("/modules/j721e/A72_2");
const A72_3       = scripting.addModule("/modules/j721e/A72_3");
const C6X_0_1     = scripting.addModule("/modules/j721e/C6X_0_1");
const C6X_1_1     = scripting.addModule("/modules/j721e/C6X_1_1");
const C7X_1       = scripting.addModule("/modules/j721e/C7X_1");
const MAIN_0_R5_0 = scripting.addModule("/modules/j721e/MAIN_0_R5_0");
const MAIN_0_R5_2 = scripting.addModule("/modules/j721e/MAIN_0_R5_2");
const MAIN_1_R5_0 = scripting.addModule("/modules/j721e/MAIN_1_R5_0");
const MAIN_1_R5_2 = scripting.addModule("/modules/j721e/MAIN_1_R5_2");
const MCU_0_R5_0  = scripting.addModule("/modules/j721e/MCU_0_R5_0");
const MCU_0_R5_2  = scripting.addModule("/modules/j721e/MCU_0_R5_2");

/**
 * Write custom configuration values to the imported modules.
 */
A72_2.Main_NAVSS_UDMA_Interrupt_aggregator_Virtual_interrupts_count = 86;
A72_2.Main_NAVSS_UDMA_Interrupt_aggregator_Global_events_count      = 1024;
A72_2.Main_NAVSS_Non_secure_proxies_count                           = 4;
A72_2.Main_NAVSS_Ring_accelerator_Free_rings_count                           = 150;
A72_2.Main_NAVSS_Ring_accelerator_ring_monitors_count                        = 3;
A72_2.Main_NAVSS_UDMA_Rx_free_flows_count                           = 16;
A72_2.Main_NAVSS_UDMA_Normal_capacity_Rx_channels_count             = 36;
A72_2.Main_NAVSS_UDMA_High_capacity_Rx_channels_count               = 4;
A72_2.Main_NAVSS_UDMA_Ultra_high_capacity_Rx_channels_count         = 2;
A72_2.Main_NAVSS_UDMA_Normal_capacity_Tx_channels_count             = 36;
A72_2.Main_NAVSS_UDMA_High_capacity_Tx_channels_count               = 4;
A72_2.Main_NAVSS_UDMA_Ultra_high_capacity_Tx_channels_count         = 2;
A72_2.Main_NAVSS_Interrupt_router_count                             = 100;
A72_2.MCU_NAVSS_Interrupt_aggregator_Virtual_interrupts_count       = 32;
A72_2.MCU_NAVSS_Interrupt_aggregator_Global_events_count            = 128;
A72_2.MCU_NAVSS_Non_secure_proxies_count                            = 4;
A72_2.MCU_NAVSS_Ring_accelerator_Free_rings_count                            = 20;
A72_2.MCU_NAVSS_Ring_accelerator_ring_monitors_count                         = 3;
A72_2.MCU_NAVSS_UDMA_Rx_free_flows_count                            = 8;
A72_2.MCU_NAVSS_UDMA_Normal_capacity_Rx_channels_count              = 12;
A72_2.MCU_NAVSS_UDMA_Normal_capacity_Tx_channels_count              = 12;
A72_2.Main_NAVSS_Ring_accelerator_virt_id_range_start                        = 2;
A72_2.Main_NAVSS_Ring_accelerator_virt_id_range_count                        = 1;
A72_2.allocOrder                                                    = 1;
A72_2.Main_GPIO_Interrupt_router_count                              = 12;
A72_2.Wakeup_GPIO_Interrupt_router_count                            = 6;

A72_3.Main_NAVSS_UDMA_Interrupt_aggregator_Virtual_interrupts_count = 32;
A72_3.Main_NAVSS_UDMA_Interrupt_aggregator_Global_events_count      = 512;
A72_3.Main_NAVSS_Non_secure_proxies_count                           = 4;
A72_3.Main_NAVSS_Ring_accelerator_Free_rings_count                           = 40;
A72_3.Main_NAVSS_Ring_accelerator_ring_monitors_count                        = 2;
A72_3.Main_NAVSS_UDMA_Rx_free_flows_count                           = 16;
A72_3.Main_NAVSS_UDMA_Normal_capacity_Rx_channels_count             = 20;
A72_3.Main_NAVSS_UDMA_Normal_capacity_Tx_channels_count             = 20;
A72_3.Main_NAVSS_Interrupt_router_count                             = 32;
A72_3.MCU_NAVSS_Interrupt_aggregator_Virtual_interrupts_count       = 16;
A72_3.MCU_NAVSS_Interrupt_aggregator_Global_events_count            = 128;
A72_3.MCU_NAVSS_Non_secure_proxies_count                            = 4;
A72_3.MCU_NAVSS_Ring_accelerator_Free_rings_count                            = 8;
A72_3.MCU_NAVSS_Ring_accelerator_ring_monitors_count                         = 2;
A72_3.MCU_NAVSS_UDMA_Rx_free_flows_count                            = 4;
A72_3.MCU_NAVSS_UDMA_Normal_capacity_Rx_channels_count              = 6;
A72_3.MCU_NAVSS_UDMA_Normal_capacity_Tx_channels_count              = 6;
A72_3.Main_NAVSS_Ring_accelerator_virt_id_range_start                        = 3;
A72_3.Main_NAVSS_Ring_accelerator_virt_id_range_count                        = 1;
A72_3.allocOrder                                                    = 2;
A72_3.Main_GPIO_Interrupt_router_count                              = 12;
A72_3.Wakeup_GPIO_Interrupt_router_count                            = 6;

C6X_0_1.Interrupt_router_for_C6X_subsystem0_count                     = 93;
C6X_0_1.Main_GPIO_Interrupt_router_count                              = 4;
C6X_0_1.Main_NAVSS_UDMA_Interrupt_aggregator_Virtual_interrupts_count = 12;
C6X_0_1.Main_NAVSS_UDMA_Interrupt_aggregator_Global_events_count      = 256;
C6X_0_1.Main_NAVSS_Non_secure_proxies_count                           = 4;
C6X_0_1.Main_NAVSS_Ring_accelerator_Free_rings_count                           = 38;
C6X_0_1.Main_NAVSS_Ring_accelerator_ring_monitors_count                        = 3;
C6X_0_1.Main_NAVSS_UDMA_Normal_capacity_Rx_channels_count             = 16;
C6X_0_1.Main_NAVSS_UDMA_Normal_capacity_Tx_channels_count             = 16;
C6X_0_1.Main_NAVSS_UDMA_extended_Tx_channels_for_DRU_count            = 6;
C6X_0_1.Main_NAVSS_Interrupt_router_count                             = 24;
C6X_0_1.MCU_NAVSS_Interrupt_aggregator_Virtual_interrupts_count       = 8;
C6X_0_1.MCU_NAVSS_Interrupt_aggregator_Global_events_count            = 64;
C6X_0_1.MCU_NAVSS_Non_secure_proxies_count                            = 4;
C6X_0_1.MCU_NAVSS_Ring_accelerator_Free_rings_count                            = 8;
C6X_0_1.MCU_NAVSS_Ring_accelerator_ring_monitors_count                         = 3;
C6X_0_1.MCU_NAVSS_UDMA_Normal_capacity_Rx_channels_count              = 2;
C6X_0_1.MCU_NAVSS_UDMA_Normal_capacity_Tx_channels_count              = 2;
C6X_0_1.allocOrder                                                    = 8;

C6X_1_1.Interrupt_router_for_C6X_subsystem1_count                     = 93;
C6X_1_1.Main_GPIO_Interrupt_router_count                              = 4;
C6X_1_1.Main_NAVSS_UDMA_Interrupt_aggregator_Virtual_interrupts_count = 12;
C6X_1_1.Main_NAVSS_UDMA_Interrupt_aggregator_Global_events_count      = 256;
C6X_1_1.Main_NAVSS_Non_secure_proxies_count                           = 4;
C6X_1_1.Main_NAVSS_Ring_accelerator_Free_rings_count                           = 12;
C6X_1_1.Main_NAVSS_Ring_accelerator_ring_monitors_count                        = 3;
C6X_1_1.Main_NAVSS_UDMA_Normal_capacity_Rx_channels_count             = 8;
C6X_1_1.Main_NAVSS_UDMA_Normal_capacity_Tx_channels_count             = 8;
C6X_1_1.Main_NAVSS_UDMA_extended_Tx_channels_for_DRU_count            = 6;
C6X_1_1.Main_NAVSS_Interrupt_router_count                             = 24;
C6X_1_1.MCU_NAVSS_Interrupt_aggregator_Virtual_interrupts_count       = 8;
C6X_1_1.MCU_NAVSS_Interrupt_aggregator_Global_events_count            = 64;
C6X_1_1.MCU_NAVSS_Non_secure_proxies_count                            = 4;
C6X_1_1.MCU_NAVSS_Ring_accelerator_Free_rings_count                            = 8;
C6X_1_1.MCU_NAVSS_Ring_accelerator_ring_monitors_count                         = 3;
C6X_1_1.MCU_NAVSS_UDMA_Normal_capacity_Rx_channels_count              = 2;
C6X_1_1.MCU_NAVSS_UDMA_Normal_capacity_Tx_channels_count              = 2;
C6X_1_1.allocOrder                                                    = 9;

C7X_1.Main_NAVSS_UDMA_Interrupt_aggregator_Virtual_interrupts_count = 12;
C7X_1.Main_NAVSS_UDMA_Interrupt_aggregator_Global_events_count      = 256;
C7X_1.Main_NAVSS_Non_secure_proxies_count                           = 4;
C7X_1.Main_NAVSS_Ring_accelerator_Free_rings_count                           = 32;
C7X_1.Main_NAVSS_Ring_accelerator_ring_monitors_count                        = 3;
C7X_1.Main_NAVSS_UDMA_Normal_capacity_Rx_channels_count             = 6;
C7X_1.Main_NAVSS_UDMA_Normal_capacity_Tx_channels_count             = 6;
C7X_1.Main_NAVSS_UDMA_extended_Tx_channels_for_DRU_count            = 16;
C7X_1.Main_NAVSS_Interrupt_router_count                             = 46;
C7X_1.MCU_NAVSS_Interrupt_aggregator_Virtual_interrupts_count       = 8;
C7X_1.MCU_NAVSS_Interrupt_aggregator_Global_events_count            = 64;
C7X_1.MCU_NAVSS_Non_secure_proxies_count                            = 4;
C7X_1.MCU_NAVSS_Ring_accelerator_Free_rings_count                            = 8;
C7X_1.MCU_NAVSS_Ring_accelerator_ring_monitors_count                         = 3;
C7X_1.MCU_NAVSS_UDMA_Normal_capacity_Rx_channels_count              = 2;
C7X_1.MCU_NAVSS_UDMA_Normal_capacity_Tx_channels_count              = 2;
C7X_1.allocOrder                                                    = 7;

MAIN_0_R5_0.Main_GPIO_Interrupt_router_count                              = 4;
MAIN_0_R5_0.Interrupt_router_for_Main_R5F_Subsystem0_count                = 128;
MAIN_0_R5_0.Wakeup_GPIO_Interrupt_router_count                            = 2;
MAIN_0_R5_0.Main_NAVSS_UDMA_Interrupt_aggregator_Virtual_interrupts_count = 28;
MAIN_0_R5_0.Main_NAVSS_UDMA_Interrupt_aggregator_Global_events_count      = 512;
MAIN_0_R5_0.Main_NAVSS_Non_secure_proxies_count                           = 12;
MAIN_0_R5_0.Main_NAVSS_Ring_accelerator_Free_rings_count                           = 182;
MAIN_0_R5_0.Main_NAVSS_Ring_accelerator_ring_monitors_count                        = 6;
MAIN_0_R5_0.Main_NAVSS_UDMA_Normal_capacity_Rx_channels_count             = 20;
MAIN_0_R5_0.Main_NAVSS_UDMA_High_capacity_Rx_channels_count               = 6;
MAIN_0_R5_0.Main_NAVSS_UDMA_Ultra_high_capacity_Rx_channels_count         = 2;
MAIN_0_R5_0.Main_NAVSS_UDMA_Normal_capacity_Tx_channels_count             = 14;
MAIN_0_R5_0.Main_NAVSS_UDMA_High_capacity_Tx_channels_count               = 6;
MAIN_0_R5_0.Main_NAVSS_UDMA_Ultra_high_capacity_Tx_channels_count         = 2;
MAIN_0_R5_0.Main_NAVSS_Interrupt_router_count                             = 28;
MAIN_0_R5_0.MCU_NAVSS_Interrupt_aggregator_Virtual_interrupts_count       = 24;
MAIN_0_R5_0.MCU_NAVSS_Interrupt_aggregator_Global_events_count            = 128;
MAIN_0_R5_0.MCU_NAVSS_Non_secure_proxies_count                            = 16;
MAIN_0_R5_0.MCU_NAVSS_Ring_accelerator_Free_rings_count                            = 16;
MAIN_0_R5_0.MCU_NAVSS_Ring_accelerator_ring_monitors_count                         = 3;
MAIN_0_R5_0.MCU_NAVSS_UDMA_Rx_free_flows_count                            = 8;
MAIN_0_R5_0.MCU_NAVSS_UDMA_Normal_capacity_Rx_channels_count              = 3;
MAIN_0_R5_0.MCU_NAVSS_UDMA_Normal_capacity_Tx_channels_count              = 3;
MAIN_0_R5_0.Main_NAVSS_UDMA_extended_Tx_channels_for_DRU_count            = 4;
MAIN_0_R5_0.Main_NAVSS_UDMA_extended_Tx_channels_for_HWA_count            = 128;
MAIN_0_R5_0.allocOrder                                                    = 10;

MAIN_0_R5_2.Main_GPIO_Interrupt_router_count                              = 4;
MAIN_0_R5_2.Interrupt_router_for_Main_R5F_Subsystem0_count                = 128;
MAIN_0_R5_2.Wakeup_GPIO_Interrupt_router_count                            = 2;
MAIN_0_R5_2.Main_NAVSS_UDMA_Interrupt_aggregator_Virtual_interrupts_count = 8;
MAIN_0_R5_2.Main_NAVSS_UDMA_Interrupt_aggregator_Global_events_count      = 256;
MAIN_0_R5_2.Main_NAVSS_Non_secure_proxies_count                           = 4;
MAIN_0_R5_2.Main_NAVSS_Ring_accelerator_Free_rings_count                           = 40;
MAIN_0_R5_2.Main_NAVSS_Ring_accelerator_ring_monitors_count                        = 3;
MAIN_0_R5_2.Main_NAVSS_UDMA_Normal_capacity_Rx_channels_count             = 2;
MAIN_0_R5_2.Main_NAVSS_UDMA_Normal_capacity_Tx_channels_count             = 6;
MAIN_0_R5_2.Main_NAVSS_Interrupt_router_count                             = 28;
MAIN_0_R5_2.MCU_NAVSS_Interrupt_aggregator_Virtual_interrupts_count       = 8;
MAIN_0_R5_2.MCU_NAVSS_Interrupt_aggregator_Global_events_count            = 128;
MAIN_0_R5_2.MCU_NAVSS_Non_secure_proxies_count                            = 4;
MAIN_0_R5_2.MCU_NAVSS_Ring_accelerator_Free_rings_count                            = 8;
MAIN_0_R5_2.MCU_NAVSS_Ring_accelerator_ring_monitors_count                         = 3;
MAIN_0_R5_2.MCU_NAVSS_UDMA_Rx_free_flows_count                            = 4;
MAIN_0_R5_2.MCU_NAVSS_UDMA_Normal_capacity_Rx_channels_count              = 2;
MAIN_0_R5_2.MCU_NAVSS_UDMA_Normal_capacity_Tx_channels_count              = 2;
MAIN_0_R5_2.allocOrder                                                    = 11;

MAIN_1_R5_0.Main_GPIO_Interrupt_router_count                              = 4;
MAIN_1_R5_0.Interrupt_router_for_Main_R5F_Subsystem1_count                = 128;
MAIN_1_R5_0.Main_NAVSS_UDMA_Interrupt_aggregator_Virtual_interrupts_count = 12;
MAIN_1_R5_0.Main_NAVSS_UDMA_Interrupt_aggregator_Global_events_count      = 256;
MAIN_1_R5_0.Main_NAVSS_Non_secure_proxies_count                           = 4;
MAIN_1_R5_0.Main_NAVSS_Ring_accelerator_Free_rings_count                           = 10;
MAIN_1_R5_0.Main_NAVSS_Ring_accelerator_ring_monitors_count                        = 3;
MAIN_1_R5_0.Main_NAVSS_UDMA_Normal_capacity_Rx_channels_count             = 6;
MAIN_1_R5_0.Main_NAVSS_UDMA_Normal_capacity_Tx_channels_count             = 6;
MAIN_1_R5_0.Main_NAVSS_Interrupt_router_count                             = 28;
MAIN_1_R5_0.MCU_NAVSS_Interrupt_aggregator_Virtual_interrupts_count       = 16;
MAIN_1_R5_0.MCU_NAVSS_Interrupt_aggregator_Global_events_count            = 128;
MAIN_1_R5_0.MCU_NAVSS_Non_secure_proxies_count                            = 4;
MAIN_1_R5_0.MCU_NAVSS_Ring_accelerator_Free_rings_count                            = 8;
MAIN_1_R5_0.MCU_NAVSS_Ring_accelerator_ring_monitors_count                         = 3;
MAIN_1_R5_0.MCU_NAVSS_UDMA_Rx_free_flows_count                            = 4;
MAIN_1_R5_0.MCU_NAVSS_UDMA_Normal_capacity_Rx_channels_count              = 2;
MAIN_1_R5_0.MCU_NAVSS_UDMA_Normal_capacity_Tx_channels_count              = 2;
MAIN_1_R5_0.allocOrder                                                    = 5;

MAIN_1_R5_2.Main_GPIO_Interrupt_router_count                              = 4;
MAIN_1_R5_2.Interrupt_router_for_Main_R5F_Subsystem1_count                = 128;
MAIN_1_R5_2.Main_NAVSS_UDMA_Interrupt_aggregator_Virtual_interrupts_count = 12;
MAIN_1_R5_2.Main_NAVSS_UDMA_Interrupt_aggregator_Global_events_count      = 256;
MAIN_1_R5_2.Main_NAVSS_Non_secure_proxies_count                           = 4;
MAIN_1_R5_2.Main_NAVSS_Ring_accelerator_Free_rings_count                           = 10;
MAIN_1_R5_2.Main_NAVSS_Ring_accelerator_ring_monitors_count                        = 3;
MAIN_1_R5_2.Main_NAVSS_UDMA_Normal_capacity_Rx_channels_count             = 6;
MAIN_1_R5_2.Main_NAVSS_UDMA_Normal_capacity_Tx_channels_count             = 6;
MAIN_1_R5_2.Main_NAVSS_Interrupt_router_count                             = 28;
MAIN_1_R5_2.MCU_NAVSS_Interrupt_aggregator_Virtual_interrupts_count       = 16;
MAIN_1_R5_2.MCU_NAVSS_Interrupt_aggregator_Global_events_count            = 128;
MAIN_1_R5_2.MCU_NAVSS_Non_secure_proxies_count                            = 4;
MAIN_1_R5_2.MCU_NAVSS_Ring_accelerator_Free_rings_count                            = 8;
MAIN_1_R5_2.MCU_NAVSS_Ring_accelerator_ring_monitors_count                         = 3;
MAIN_1_R5_2.MCU_NAVSS_UDMA_Rx_free_flows_count                            = 4;
MAIN_1_R5_2.MCU_NAVSS_UDMA_Normal_capacity_Rx_channels_count              = 2;
MAIN_1_R5_2.MCU_NAVSS_UDMA_Normal_capacity_Tx_channels_count              = 2;
MAIN_1_R5_2.allocOrder                                                    = 6;

MCU_0_R5_0.Main_2_MCU_Level_Interrupt_router_count                  = 32;
MCU_0_R5_0.Main_2_MCU_Pulse_Interrupt_router_count                  = 24;
MCU_0_R5_0.Main_GPIO_Interrupt_router_count                         = 8;
MCU_0_R5_0.Wakeup_GPIO_Interrupt_router_count                       = 8;
MCU_0_R5_0.Main_NAVSS_UDMA_Interrupt_aggregator_Global_events_count = 32;
MCU_0_R5_0.Main_NAVSS_Non_secure_proxies_count                      = 4;
MCU_0_R5_0.Main_NAVSS_Ring_accelerator_Free_rings_count                      = 6;
MCU_0_R5_0.Main_NAVSS_UDMA_Normal_capacity_Rx_channels_count        = 2;
MCU_0_R5_0.Main_NAVSS_UDMA_Normal_capacity_Tx_channels_count        = 2;
MCU_0_R5_0.Main_NAVSS_Interrupt_router_count                        = 4;
MCU_0_R5_0.MCU_NAVSS_Interrupt_aggregator_Virtual_interrupts_count  = 64;
MCU_0_R5_0.MCU_NAVSS_Interrupt_aggregator_Global_events_count       = 256;
MCU_0_R5_0.MCU_NAVSS_Non_secure_proxies_count                       = 4;
MCU_0_R5_0.MCU_NAVSS_Ring_accelerator_Free_rings_count                       = 32;
MCU_0_R5_0.MCU_NAVSS_Ring_accelerator_ring_monitors_count                    = 3;
MCU_0_R5_0.MCU_NAVSS_UDMA_Rx_free_flows_count                       = 8;
MCU_0_R5_0.MCU_NAVSS_UDMA_Normal_capacity_Rx_channels_count         = 5;
MCU_0_R5_0.MCU_NAVSS_UDMA_High_capacity_Rx_channels_count           = 2;
MCU_0_R5_0.MCU_NAVSS_UDMA_Normal_capacity_Tx_channels_count         = 5;
MCU_0_R5_0.MCU_NAVSS_UDMA_High_capacity_Tx_channels_count           = 2;
MCU_0_R5_0.MCU_NAVSS_Interrupt_router_count                         = 28;
MCU_0_R5_0.Main_NAVSS_Ring_accelerator_ring_monitors_count                   = 1;
MCU_0_R5_0.shareResource                                            = "MCU_0_R5_1";
MCU_0_R5_0.allocOrder                                               = 3;

MCU_0_R5_2.Main_2_MCU_Level_Interrupt_router_count                  = 32;
MCU_0_R5_2.Main_2_MCU_Pulse_Interrupt_router_count                  = 24;
MCU_0_R5_2.Main_GPIO_Interrupt_router_count                         = 8;
MCU_0_R5_2.Wakeup_GPIO_Interrupt_router_count                       = 8;
MCU_0_R5_2.Main_NAVSS_UDMA_Interrupt_aggregator_Global_events_count = 32;
MCU_0_R5_2.Main_NAVSS_Non_secure_proxies_count                      = 4;
MCU_0_R5_2.Main_NAVSS_Ring_accelerator_Free_rings_count                      = 6;
MCU_0_R5_2.Main_NAVSS_Ring_accelerator_ring_monitors_count                   = 1;
MCU_0_R5_2.Main_NAVSS_UDMA_Normal_capacity_Rx_channels_count        = 2;
MCU_0_R5_2.Main_NAVSS_UDMA_Normal_capacity_Tx_channels_count        = 2;
MCU_0_R5_2.Main_NAVSS_Interrupt_router_count                        = 4;
MCU_0_R5_2.MCU_NAVSS_Interrupt_aggregator_Virtual_interrupts_count  = 4;
MCU_0_R5_2.MCU_NAVSS_Interrupt_aggregator_Global_events_count       = 64;
MCU_0_R5_2.MCU_NAVSS_Non_secure_proxies_count                       = 4;
MCU_0_R5_2.MCU_NAVSS_Ring_accelerator_Free_rings_count                       = 12;
MCU_0_R5_2.MCU_NAVSS_Ring_accelerator_ring_monitors_count                    = 3;
MCU_0_R5_2.MCU_NAVSS_UDMA_Rx_free_flows_count                       = 4;
MCU_0_R5_2.MCU_NAVSS_UDMA_Normal_capacity_Rx_channels_count         = 2;
MCU_0_R5_2.MCU_NAVSS_UDMA_Normal_capacity_Tx_channels_count         = 2;
MCU_0_R5_2.MCU_NAVSS_Interrupt_router_count                         = 28;
MCU_0_R5_2.allocOrder                                               = 4;
