/**
 * These arguments were used when this file was generated. They will be automatically applied on subsequent loads
 * via the GUI or CLI. Run CLI with '--help' for additional information on how to override these arguments.
 * @cliArgs --device "AM437x" --package "ZDN" --part "Default" --product "K3-Respart-Tool@0.5"
 * @versions {"data":"2020052503","timestamp":"2020052503","tool":"1.6.0+1393","templates":"2020052503"}
 */

/**
 * Import the modules used in this configuration.
 */
const A53_2       = scripting.addModule("/modules/am64x/A53_2");
const M4_0        = scripting.addModule("/modules/am64x/M4_0");
const MAIN_0_R5_0 = scripting.addModule("/modules/am64x/MAIN_0_R5_0");
const MAIN_0_R5_2 = scripting.addModule("/modules/am64x/MAIN_0_R5_2");
const MAIN_1_R5_0 = scripting.addModule("/modules/am64x/MAIN_1_R5_0");
const MAIN_1_R5_2 = scripting.addModule("/modules/am64x/MAIN_1_R5_2");

/**
 * Write custom configuration values to the imported modules.
 */
A53_2.allocOrder = 1;

M4_0.allocOrder = 6;

MAIN_0_R5_0.allocOrder = 2;

MAIN_0_R5_2.allocOrder = 3;

MAIN_1_R5_0.allocOrder = 4;

MAIN_1_R5_2.allocOrder = 5;
